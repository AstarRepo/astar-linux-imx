// SPDX-License-Identifier: (GPL-2.0+ OR MIT)
/*
 * Copyright 2024 SomLabs Astar
 *
 */

#include "spacesom-8mplus-cb-gcsomtst3.dtsi"
#include "spacesom-8mplus-cb-panel-wf101ktyapmnb0.dtsi"

/ {
        model = "SoMLabs SpaceSOM i.MX8MPlus CB-GC-SOM-TST3 wf101ktyapmnb0";
};
