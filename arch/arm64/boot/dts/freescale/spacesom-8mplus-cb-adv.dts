// SPDX-License-Identifier: (GPL-2.0+ OR MIT)
/*
 * Copyright 2022 SomLabs Astar
 *
 */

#include "spacesom-8mplus-cb-adv.dtsi"
//#include "spacesom-8mplus-cb-panel-dlc1010ebp28mf.dtsi"
#include "spacesom-8mplus-cb-panel-at101qmij-300cp.dtsi"

/ {
        model = "SoMLabs SpaceSOM i.MX8MPlus CB-ADV no panel";
};
